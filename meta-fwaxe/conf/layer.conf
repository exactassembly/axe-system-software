## meta-fwaxe/conf/layer.conf
```bitbake
# We have a conf and classes directory, append to BBPATH
BBPATH .= ":${LAYERDIR}"

# We have a recipes directory, add to BBFILES
BBFILES += "${LAYERDIR}/recipes*/*/*.bb ${LAYERDIR}/recipes*/*/*.bbappend"

BBFILE_COLLECTIONS += "meta-fwaxe"
BBFILE_PATTERN_meta-fwaxe := "^${LAYERDIR}/"

LAYERSERIES_COMPAT_meta-fwaxe = "mickledore"
```

## meta-howto/conf/layer.conf
```bitbake
# We have a conf and classes directory, append to BBPATH
BBPATH .= ":${LAYERDIR}"

# We have a recipes directory, add to BBFILES
BBFILES += "${LAYERDIR}/recipes*/*/*.bb ${LAYERDIR}/recipes*/*/*.bbappend"

BBFILE_COLLECTIONS += "meta-howto"
BBFILE_PATTERN_meta-howto := "^${LAYERDIR}/"

LAYERSERIES_COMPAT_meta-howto = "kirkstone"
```
